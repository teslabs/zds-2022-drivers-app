## drivers/lock/Kconfig
```kconfig
menuconfig LOCK
	bool "Locks"

if LOCK

module = LOCK
module-str = lock
source "subsys/logging/Kconfig.template.log_config"

config LOCK_INIT_PRIORITY
	int "Lock init priority"
	default 90
	help
	  Lock initialization priority.

rsource "Kconfig.servo"

endif # LOCK
```

## drivers/lock/Kconfig.servo
```kconfig
config LOCK_SERVO
	bool "Servo-controlled lock"
	default y
	depends on DT_HAS_LOCK_SERVO_ENABLED
	select PWM
	select ADC
	help
	  Enables a servo-controlled lock driver.
```

## drivers/sensor/Kconfig
```kconfig
# Copyright (c) 2022 Nordic Semiconductor ASA
# SPDX-License-Identifier: Apache-2.0

if SENSOR
rsource "jm101/Kconfig"
endif # SENSOR
```

## drivers/sensor/jm101/Kconfig
```kconfig
# Copyright (c) 2022 Nordic Semiconductor ASA
# SPDX-License-Identifier: Apache-2.0

config JM101
	bool "JM-101 fingerprint sensor"
	default y
	depends on DT_HAS_ZEANTEC_JM101_ENABLED
	select GPIO
	select SERIAL
	select UART_INTERRUPT_DRIVEN
	help
	  JM-101 fingerprint sensor.

config JM101_TRIGGER
	bool "SYNODATA JM101 touch input support"
	depends on JM101
	help
	  When enabled, the JM101 can be provided with a touch input GPIO to
	  trigger fingerprint readings.
```

## dts/bindings/lock/lock-servo.yaml
```yaml
# Copyright (c) 2022 Nordic Semiconductor ASA
# SPDX-License-Identifier: Apache-2.0

description: Lock driven by a servo

compatible: "lock-servo"

include: base.yaml

properties:
    pwms:
      required: true
      type: phandle-array
      description: |
        PWM specifier driving the servo motor.

    open-pulse-us:
      required: true
      type: int
      description: |
        Lock open position pulse width (microseconds).

    closed-pulse-us:
      required: true
      type: int
      description: |
        Lock closed position pulse width (microseconds).

    io-channels:
      required: true
      type: phandle-array
      description: |
        ADC specifier for servo feedback.

    fb-gain:
      required: true
      type: int
      description: |
        Servo feedback gain (uV/usec).

    fb-offset-microvolt:
      required: true
      type: int
      description: |
        Servo feedback offset (uV).

    max-target-err-us:
      required: true
      type: int
      description: |
        Maximum target pulse error (+/-), in microseconds.

    max-action-time-ms:
      required: true
      type: int
      description: |
        Maximum time to complete open/close actions (msec).
```

## dts/bindings/sensor/zeantec,jm101.yaml
```yaml
# Copyright (c) 2022 Nordic Semiconductor ASA
# SPDX-License-Identifier: Apache-2.0

description: |
  JM-101 is a fingerprint sensor. It is based on Synochip AS608 MCU. It is sold
  with many names, e.g. AS608, JM-101, FPM10A/DYI50, etc.

compatible: "zeantec,jm101"

include: base.yaml

properties:
  reg:
    required: true

  touch-gpios:
    type: phandle-array
    required: false
    description: |
      Touch input GPIO (active high). When the sensor is touched, the GPIO is
      set to high. It is used to trigger a fingerprint read.
```
